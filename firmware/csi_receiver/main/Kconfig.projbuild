## firmware/csi_receiver/main/Kconfig.projbuild
```kconfig
menu "CSI Receiver Configuration"

config CSI_RX_CHANNEL
    int "WiFi channel (must match transmitter AND host hotspot)"
    range 1 13
    default 11

config CSI_RX_FILTER_TX_MAC
    string "Transmitter MAC filter(s) (blank = accept all)"
    default ""
    help
        Source-MAC allowlist. Only CSI samples whose source MAC matches
        one of these addresses are emitted. Single MAC:

            aa:bb:cc:dd:ee:ff
            aabbccddeeff

        Multiple MACs (multi-TX setups), comma- or semicolon-separated:

            aa:bb:cc:dd:ee:ff, 11:22:33:44:55:66

        Up to 4 MACs supported. If any token is malformed, the receiver
        logs an error at boot and disables the filter rather than
        silently passing partial filters.

config CSI_RX_WIFI_SSID
    string "Hotspot SSID for UDP forwarding (blank = UART-only)"
    default ""
    help
        If set, the receiver associates as a STA to this SSID after
        bringing up promiscuous CSI capture. Each CSI sample is sent
        as a binary UDP packet to CSI_RX_HOST_IP:CSI_RX_HOST_PORT, in
        addition to being printed over UART. Must be on the same
        channel as the transmitter (CSI_RX_CHANNEL) — the radio
        cannot capture CSI on one channel while associated to an AP
        on another.

config CSI_RX_WIFI_PASS
    string "Hotspot password"
    default ""

config CSI_RX_HOST_IP
    string "Host IP address (UDP destination)"
    default "10.42.0.1"

config CSI_RX_HOST_PORT
    int "Host UDP port"
    range 1 65535
    default 5566

endmenu
```

## firmware/csi_transmitter/main/Kconfig.projbuild
```kconfig
menu "CSI Transmitter Configuration"

config CSI_TX_CHANNEL
    int "WiFi channel (ESP-NOW)"
    range 1 13
    default 11
    help
        Both transmitter and receiver must be on the same channel.
        Channel 11 typically has the least interference in the 2.4 GHz band.

config CSI_TX_RATE_HZ
    int "Broadcast rate (Hz)"
    range 1 500
    default 100
    help
        How often we broadcast an ESP-NOW packet. Each broadcast triggers one
        CSI sample on every receiver, so this is the effective sample rate.

endmenu
```
